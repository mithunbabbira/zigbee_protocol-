## components/switch_driver/Kconfig
```kconfig
menu "Shelf GPIO Configuration"
    config GPIO_BOOT_ON_DEVKIT
        int "BOOT GPIO on devkit"
        default 9 if IDF_TARGET_ESP32C6
        default 9
        help
            GPIO connected to the BOOT button used as shelf button surrogate.

    config GPIO_STATUS_LED_ON_DEVKIT
        int "RGB status LED GPIO on devkit"
        default 8 if IDF_TARGET_ESP32C6
        default 8
        help
            GPIO for the onboard WS2812 RGB LED (ESP32-C6-DevKitC-1 uses GPIO8).
endmenu
```

## firmware/coordinator/sdkconfig.defaults
```kconfig
CONFIG_IDF_TARGET="esp32c6"

CONFIG_PARTITION_TABLE_CUSTOM=y
CONFIG_PARTITION_TABLE_CUSTOM_FILENAME="partitions.csv"

CONFIG_ZB_ENABLED=y
CONFIG_ZB_ZCZR=y
CONFIG_ZB_COORDINATOR_ROLE=y

CONFIG_ESP_CONSOLE_USB_SERIAL_JTAG=y
CONFIG_ESP_CONSOLE_UART_DEFAULT=n
```

## firmware/shelf_node/main/Kconfig.projbuild
```kconfig
menu "Shelf Zigbee Node"

    choice SHELF_DEVICE_ROLE
        prompt "Zigbee device role"
        default SHELF_DEVICE_ROLE_END_DEVICE
        help
            Router: relays traffic for other shelves (pick one unit if the dongle is far away).
            End device: lower power, joins through a router or the coordinator directly.

        config SHELF_DEVICE_ROLE_ROUTER
            bool "Router (ZR)"

        config SHELF_DEVICE_ROLE_END_DEVICE
            bool "End device (ZED)"
    endchoice

    config SHELF_JOIN_ALL_CHANNELS
        bool "Scan all Zigbee channels when joining"
        default y
        help
            Required when joining an external coordinator (e.g. SONOFF ZBDongle-E via Zigbee2MQTT).
            Disable to lock joins to channel 15 only (legacy ESP32 coordinator bench setup).

endmenu
```

## firmware/shelf_node/sdkconfig.defaults
```kconfig
CONFIG_IDF_TARGET="esp32c6"

CONFIG_PARTITION_TABLE_CUSTOM=y
CONFIG_PARTITION_TABLE_CUSTOM_FILENAME="partitions.csv"

CONFIG_ZB_ENABLED=y
CONFIG_ZB_ZCZR=y

CONFIG_GPIO_BOOT_ON_DEVKIT=9
CONFIG_GPIO_STATUS_LED_ON_DEVKIT=8

CONFIG_SHELF_JOIN_ALL_CHANNELS=y
# End device profile for SONOFF dongle / Zigbee2MQTT
CONFIG_SHELF_DEVICE_ROLE_END_DEVICE=y
# CONFIG_SHELF_DEVICE_ROLE_ROUTER is not set
```
